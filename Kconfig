## Kconfig
```kconfig
menu "ESP32-Config"

    config APP_CONFIG_NVS_NAMESPACE
        string "NVS configuration namespace"
        default "configuration"
        help
            Sets NVS namespace for storing configuration data.

    config APP_CONFIG_FILE_NAME
        string "Configuration filename"
        default "conf.json"
        help
            Filename of JSON file containing configuration declaration.

    config APP_CONFIG_ELT_NAME_LEN
        int "Name length"
        default 32
        help
            Maximum element's or topic's name length.

    config APP_CONFIG_SHORT_NAME_LEN
        int "Short name length"
        default 32
        help
            Maximum element's or topic's short name length.

    config APP_CONFIG_CSS_FILE
        string "CSS filename"
        default "main.css"
        help
            Filename of CSS file for configuration page.    

    config APP_CONFIG_REST_PATH
        string "Path for REST config"
        default "/config"
        help
            HTTP path for JSON config.

    config APP_CONFIG_HTML_GET_PATH
        string "Configuration page path"
        default "/"
        help
            HTTP path for configuration HTML page.

    config APP_CONFIG_HTML_SET_PATH
        string "Configuration set path"
        default "/set"
        help
            HTTP path for setting configuration data

    config APP_CONFIG_MINIMIZE_HTML
        bool "Minimize HTML"
        default y
        help
            Try to create more compact HTML.

    config APP_CONFIG_BLUETOOTH_MESH
        bool "Bluetooth Mesh support"
        default n
        help
            Generate code for Bluetooth Mesh elements.

    config APP_CONFIG_OTA
        bool "Over-the-air update support"
        default y
        help
            Generate code for OTA updates.

    config APP_CONFIG_BLE_MESH_FILE_NAME
        string "BLE Mesh configuration filename"
        default "conf_ble_mesh.json"
        depends on APP_CONFIG_BLUETOOTH_MESH
        help
            Filename of JSON file containing declaration for Bluetooth Mesh functions.
    
    menu "MQTT options"
        config APP_CONFIG_MQTT_BROKER_LEN
            int "Broker length"
            default 32
            help
                Maximum MQTT broker's address length.
    
        config APP_CONFIG_MQTT_USER_LEN
            int "MQTT username length"
            default 32
            help
                Maximum username lenght for MQTT auth.
    
        config APP_CONFIG_MQTT_PASS_LEN
            int "MQTT password length"
            default 32
            help
                Maximum password lenght for MQTT auth.
        
        config APP_CONFIG_MQTT_PREFIX_LEN
            int "MQTT prefix length"
            default 32
            help
                Maximum lenght for MQTT topic's prefix.

        config APP_CONFIG_MQTT_OBJID_LEN
            int "MQTT object ID length"
            default 32
            help
                Maximum lenght for object ID part in MQTT topic.

        config APP_CONFIG_MQTT_MAX_TOPIC_SUB
            int "Max subscriptions number"
            default 50
            help
                Maximum number of topic subscriptions for application
        
        menu "MQTT Switch"
            config APP_CONFIG_MQTT_SWITCH_STATE_STR
                string "MQTT switch state topic suffix"
                default ""
                help
                    Default suffix string to create MQTT switch's state topic string
            config APP_CONFIG_MQTT_SWITCH_CMD_STR
                string "MQTT switch command topic suffix"
                default "/set"
                help
                    Default suffix string to create MQTT switch's command topic string
            config APP_CONFIG_MQTT_SWITCH_AVAIL_STR
                string "MQTT switch availability topic suffix"
                default "/available"
                help
                    Default suffix string to create MQTT switch's availability topic string
            config APP_CONFIG_MQTT_SWITCH_ON_STR
                string "MQTT switch's ON payload"
                default "ON"
                help
                    Default string for MQTT switch's ON-state payload
            config APP_CONFIG_MQTT_SWITCH_OFF_STR
                string "MQTT switch's OFF payload"
                default "OFF"
                help
                    Default string for MQTT switch's OFF-state payload
        endmenu # MQTT Switch
        menu "MQTT Light"
            config APP_CONFIG_MQTT_LIGHT_BRIGHTNESS_STATE_STR
                string "MQTT light brightness state topic suffix"
                default "/brightness"
                help
                    Default suffix string to create MQTT light's brightness state topic string
            config APP_CONFIG_MQTT_LIGHT_BRIGHTNESS_CMD_STR
                string "MQTT light brightness command topic suffix"
                default "/brightness/set"
                help
                    Default suffix string to create MQTT light's brightness command topic string
        endmenu # MQTT Light
    endmenu # "MQTT options"
    menu "OTA"
        config APP_CONFIG_OTA_URL_LEN
            int "OTA URL length"
            default 50
            depends on APP_CONFIG_OTA
            help
                URL length to check updates
    endmenu # "OTA"

endmenu # ESP32-Config
```
